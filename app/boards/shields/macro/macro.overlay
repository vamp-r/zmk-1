/ {
    chosen {
        zmk,kscan = &kscan0;
    };

    kscan0: kscan_0 {
        compatible = "zmk,kscan-gpio-matrix";
        label = "KSCAN";
        diode-direction = "col2row";

        col-gpios
            = <&gpiob 14 GPIO_ACTIVE_HIGH>
            , <&gpiob 15 GPIO_ACTIVE_HIGH>
            , <&gpioa 8 GPIO_ACTIVE_HIGH>
            , <&gpioa 9 GPIO_ACTIVE_HIGH>
            ;

        row-gpios
            = <&gpiob 12  (GPIO_ACTIVE_HIGH | GPIO_PULL_DOWN)>
            , <&gpiob 13  (GPIO_ACTIVE_HIGH | GPIO_PULL_DOWN)>
            ;
    };
};