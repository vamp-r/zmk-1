## app/board=blackpill_f411ce/Kconfig/Kconfig.modules
```kconfig
menu "hal_nordic (C:\Users\pablo\1\zmk\modules\hal\nordic)"
osource "$(ZEPHYR_HAL_NORDIC_KCONFIG)"
config ZEPHYR_HAL_NORDIC_MODULE
	bool
	default y
endmenu
menu "sof (C:\Users\pablo\1\zmk\modules\audio\sof)"
osource "C:/Users/pablo/1/zmk/modules/audio/sof/zephyr/Kconfig"
config ZEPHYR_SOF_MODULE
	bool
	default y
endmenu
menu "drivers (C:\Users\pablo\1\zmk\app\drivers)"
osource "C:/Users/pablo/1/zmk/app/drivers/Kconfig"
config ZEPHYR_DRIVERS_MODULE
	bool
	default y
endmenu
```
